## main/Kconfig.projbuild
```kconfig
menu "Explorer IRBlaster Test Configuration"

    config ENABLE_FRAM_TESTS
        bool "Enable MB85RS512T FRAM Unit/Integration Tests"
        default n
        help
            Ativa a execução dos testes automatizados de leitura, escrita,
            status register e validação dos offsets da memória FRAM durante o boot na main.c.

    config OLED_I2C_ADDRESS
            hex "OLED I2C Address"
            default 0x3C
            help
                I2C slave address for SSD1306/SH1106 OLED display (typically 0x3C or 0x3D).

        config OLED_RUN_TESTS
            bool "Enable OLED Component Hardware Tests"
            default n
            help
                Enables standalone test suite execution for the OLED display inside app_main().

    config RTC_HT8563_TEST_READ_DATETIME
        bool "Habilitar Teste 1: Leitura Continuada de Data/Hora"
        default y
        help
          Lê periodicamente a data e hora do RTC e exibe no ESP_LOG.

    config RTC_HT8563_TEST_ALARM_INT
        bool "Habilitar Teste 2: Interrupção por Alarme de Hora"
        default n
        help
          Lida/limpa as flags de interrupção e agenda o alarme para acionar a saída INT.

    config RTC_HT8563_TEST_TIMER_INT
        bool "Habilitar Teste 3: Interrupção por Timer Countdown"
        default n
        help
          Limpa as flags e ativa o timer regressivo do RTC para gerar pulso de interrupção.

    config MQTT_BROKER_URI
        string "MQTT Broker URI"
        default "mqtt://broker.hivemq.com:1883"
        help
            URI de conexão do Broker MQTT (ex: mqtt://broker.hivemq.com:1883).

    config MQTT_BUFFER_SIZE
        int "MQTT Rx Buffer Size (bytes)"
        default 2048
        help
            Tamanho em bytes do buffer de entrada (Rx) do cliente MQTT para recepção de payloads JSON grandes.

    config MQTT_OUT_BUFFER_SIZE
        int "MQTT Tx Buffer Size (bytes)"
        default 2048
        help
            Tamanho em bytes do buffer de saída (Tx) do cliente MQTT para envio de mensagens.

endmenu
```
