#include "display.h"
#include "config.h"
#include <string.h>
#include "driver/i2c_master.h"
#include "esp_log.h"

// Tabela de fonte ASCII completa (32 a 126) em matriz 8x8
static const uint8_t font8x8[95][8] = {
    {0x00, 0x00, 0x00, 0x00, 0x00, 0x00, 0x00, 0x00}, // ' ' (32)
    {0x00, 0x00, 0x5f, 0x00, 0x00, 0x00, 0x00, 0x00}, // '!'
    {0x00, 0x07, 0x00, 0x07, 0x00, 0x00, 0x00, 0x00}, // '"'
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    {0x02, 0x01, 0x02, 0x04, 0x02, 0x00, 0x00, 0x00}  // '~'
};

static uint8_t frame_buffer[1024];
static i2c_master_dev_handle_t oled_dev_handle;

static void oled_send_cmd(uint8_t cmd) {
    uint8_t tx_buf[2] = {0x00, cmd};
    i2c_master_transmit(oled_dev_handle, tx_buf, 2, -1);
}

void display_power(bool turn_on) {
    oled_send_cmd(turn_on ? 0xAF : 0xAE);
}

static void oled_update_screen(void) {
    oled_send_cmd(0x21); oled_send_cmd(0); oled_send_cmd(127);
    oled_send_cmd(0x22); oled_send_cmd(0); oled_send_cmd(7);

    uint8_t tx_buf[1025];
    tx_buf[0] = 0x40;
    memcpy(&tx_buf[1], frame_buffer, 1024);
    i2c_master_transmit(oled_dev_handle, tx_buf, 1025, -1);
}

void display_clear(void) {
    memset(frame_buffer, 0x00, sizeof(frame_buffer));
    oled_update_screen();
}

void display_show_text(const char *str) {
    memset(frame_buffer, 0x00, sizeof(frame_buffer));
    
    // Começa na página 2 (linha de cima) para centralizar verticalmente as 2 linhas
    int page = 2;
    int x = 0;

    // Calcula a largura da linha atual para centralizar horizontalmente
    const char *line_start = str;
    int line_len = 0;
    while (line_start[line_len] != '\0' && line_start[line_len] != '\n') {
        line_len++;
    }
    if (line_len * 8 < 128) {
        x = (128 - (line_len * 8)) / 2;
    }

    while (*str) {
        // Trata a quebra de linha \n
        if (*str == '\n') {
            page += 2; // Pula 2 páginas (16 pixels) para a linha de baixo
            if (page > 6) break; // Evita estourar o limite inferior do display

            // Recalcula o alinhamento horizontal para a segunda linha
            const char *next_line = str + 1;
            line_len = 0;
            while (next_line[line_len] != '\0' && next_line[line_len] != '\n') {
                line_len++;
            }
            x = (line_len * 8 < 128) ? (128 - (line_len * 8)) / 2 : 0;

            str++;
            continue;
        }

        // Renderiza o caractere se ainda couber na largura do display
        if (x <= (128 - 8)) {
            uint8_t c = (uint8_t)*str;
            if (c >= 32 && c <= 126) {
                uint8_t font_idx = c - 32;
                for (int i = 0; i < 8; i++) {
                    frame_buffer[(page * 128) + x + i] = font8x8[font_idx][i];
                }
            }
            x += 8;
        }
        str++;
    }

    oled_update_screen();
}

void display_init(void) {
    i2c_master_bus_config_t i2c_bus_config = {
        .clk_source = I2C_CLK_SRC_DEFAULT,
        .i2c_port = I2C_PORT_NUM,
        .scl_io_num = I2C_SCL_PIN,
        .sda_io_num = I2C_SDA_PIN,
        .glitch_ignore_cnt = 7,
        .flags.enable_internal_pullup = true,
    };
    i2c_master_bus_handle_t bus_handle;
    ESP_ERROR_CHECK(i2c_new_master_bus(&i2c_bus_config, &bus_handle));

    i2c_device_config_t dev_config = {
        .dev_addr_length = I2C_ADDR_BIT_LEN_7,
        .device_address = OLED_I2C_ADDRESS,
        .scl_speed_hz = 400 * 1000,
    };
    ESP_ERROR_CHECK(i2c_master_bus_add_device(bus_handle, &dev_config, &oled_dev_handle));

    uint8_t cmds[] = {
        0xAE, 0xD5, 0x80, 0xA8, 0x3F, 0xD3, 0x00, 0x40,
        0x8D, 0x14, 0x20, 0x00, 0xA1, 0xC8, 0xDA, 0x12,
        0x81, 0xCF, 0xD9, 0xF1, 0xDB, 0x40, 0xA4, 0xA6
    };
    for(size_t i = 0; i < sizeof(cmds); i++) {
        oled_send_cmd(cmds[i]);
    }
    
    display_clear();
    display_power(false);
}